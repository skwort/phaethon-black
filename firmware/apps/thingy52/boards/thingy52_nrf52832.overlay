/* MPU9250 Overlay */
&i2c0 {
    mpu9250: mpu9250@68 {
		compatible = "invensense,mpu9250";
		reg = <0x68>;
		vin-supply = <&mpu_pwr>;
    gyro-sr-div = <0>;
    gyro-fs = <250>;      // Full-scale +/- 250 rads/s
    gyro-dlpf = <10>;     // Cutoff at 10 Hz
    accel-fs = <2>;       // Full-scale +/- wg
    accel-dlpf = "10.2";  // Cutoff 10.2 Hz
	};
};